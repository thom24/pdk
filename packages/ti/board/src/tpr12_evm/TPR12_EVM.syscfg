/**
 * These arguments were used when this file was generated. They will be automatically applied on subsequent loads
 * via the GUI or CLI. Run CLI with '--help' for additional information on how to override these arguments.
 * @cliArgs --device "TPR12" --package "ZCE" --part "Default" --product "TPR12@0.0.1"
 * @versions {"data":"2020091410","timestamp":"2020091410","tool":"1.0.0+dev","templates":"2020091410"}
 */

/**
 * Import the modules used in this configuration.
 */
const MSS_I2C      = scripting.addModule("/TPR12/MSS_I2C", {}, false);
const MSS_I2C1     = MSS_I2C.addInstance();
const MSS_RGMII    = scripting.addModule("/TPR12/MSS_RGMII", {}, false);
const MSS_RGMII1   = MSS_RGMII.addInstance();
const MSS_RS232    = scripting.addModule("/TPR12/MSS_RS232", {}, false);
const MSS_RS2321   = MSS_RS232.addInstance();
const PMIC_CLKOUT  = scripting.addModule("/TPR12/PMIC_CLKOUT", {}, false);
const PMIC_CLKOUT1 = PMIC_CLKOUT.addInstance();
const RCSS_GPIO    = scripting.addModule("/TPR12/RCSS_GPIO", {}, false);
const RCSS_GPIO1   = RCSS_GPIO.addInstance();
const RCSS_GPIO2   = RCSS_GPIO.addInstance();
const RCSS_GPIO3   = RCSS_GPIO.addInstance();
const RCSS_GPIO4   = RCSS_GPIO.addInstance();
const RCSS_GPIO5   = RCSS_GPIO.addInstance();
const RCSS_GPIO6   = RCSS_GPIO.addInstance();
const RCSS_GPIO7   = RCSS_GPIO.addInstance();
const RCSS_GPIO8   = RCSS_GPIO.addInstance();

/**
 * Write custom configuration values to the imported modules.
 */
MSS_I2C1.$name              = "TPR12_MSS_I2C0";
MSS_I2C1.periph.$assign     = "MSS_I2CA";
MSS_I2C1.periph.SCL.pull    = "pu";
MSS_I2C1.periph.SCL.$assign = "PAD_BZ";
MSS_I2C1.periph.SDA.pull    = "pu";
MSS_I2C1.periph.SDA.$assign = "PAD_BY";

MSS_RGMII1.$name               = "TPR12_MSS_RGMII0";
MSS_RGMII1.periph.$assign      = "MSS_RGMII0";
MSS_RGMII1.periph.TCTL.$assign = "PAD_CA";
MSS_RGMII1.periph.RCTL.$assign = "PAD_CB";
MSS_RGMII1.periph.TD3.$assign  = "PAD_CC";
MSS_RGMII1.periph.TD2.$assign  = "PAD_CD";
MSS_RGMII1.periph.TD1.$assign  = "PAD_CE";
MSS_RGMII1.periph.TD0.$assign  = "PAD_CF";
MSS_RGMII1.periph.TCLK.$assign = "PAD_CG";
MSS_RGMII1.periph.RCLK.$assign = "PAD_CH";
MSS_RGMII1.periph.RD3.$assign  = "PAD_CI";
MSS_RGMII1.periph.RD2.$assign  = "PAD_CJ";
MSS_RGMII1.periph.RD1.$assign  = "PAD_CK";
MSS_RGMII1.periph.RD0.$assign  = "PAD_CL";

MSS_RS2321.$name             = "TPR12_MSS_RS2320";
MSS_RS2321.periph.$assign    = "MSS_RS2320";
MSS_RS2321.periph.RX.$assign = "PAD_BD";
MSS_RS2321.periph.TX.$assign = "PAD_BE";

PMIC_CLKOUT1.$name                 = "TPR12_PMIC_CLKOUT0";
PMIC_CLKOUT1.periph.$assign        = "PMIC_CLKOUT0";
PMIC_CLKOUT1.periph.CLKOUT.$assign = "PAD_BA";

RCSS_GPIO1.$name              = "TPR12_RCSS_GPIO50";
RCSS_GPIO1.periph.$assign     = "RCSS_GPIO50";
RCSS_GPIO1.periph.PIN.$assign = "PAD_DW";

RCSS_GPIO2.$name              = "TPR12_RCSS_GPIO34";
RCSS_GPIO2.periph.$assign     = "RCSS_GPIO34";
RCSS_GPIO2.periph.PIN.$assign = "PAD_CS";

RCSS_GPIO3.$name              = "TPR12_RCSS_GPIO48";
RCSS_GPIO3.periph.$assign     = "RCSS_GPIO48";
RCSS_GPIO3.periph.PIN.$assign = "PAD_DU";

RCSS_GPIO4.$name              = "TPR12_RCSS_GPIO42";
RCSS_GPIO4.periph.$assign     = "RCSS_GPIO42";
RCSS_GPIO4.periph.PIN.$assign = "PAD_CY";

RCSS_GPIO5.$name              = "TPR12_RCSS_GPIO51";
RCSS_GPIO5.periph.$assign     = "RCSS_GPIO51";
RCSS_GPIO5.periph.PIN.$assign = "PAD_DX";

RCSS_GPIO6.$name              = "TPR12_RCSS_GPIO35";
RCSS_GPIO6.periph.$assign     = "RCSS_GPIO35";
RCSS_GPIO6.periph.PIN.$assign = "PAD_CX";

RCSS_GPIO7.$name              = "TPR12_RCSS_GPIO49";
RCSS_GPIO7.periph.$assign     = "RCSS_GPIO49";
RCSS_GPIO7.periph.PIN.$assign = "PAD_DV";

RCSS_GPIO8.$name              = "TPR12_RCSS_GPIO43";
RCSS_GPIO8.periph.$assign     = "RCSS_GPIO43";
RCSS_GPIO8.periph.PIN.$assign = "PAD_CZ";
